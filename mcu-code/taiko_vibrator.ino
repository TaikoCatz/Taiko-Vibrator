const int kPinPwm1 = 9;
const int kPwmPeriodMs = 10;

const int kYuugenLen = 1262;
extern const uint32_t kYuugenData[1262] PROGMEM;

const int kPhaseLen = 8;
const int kPhaseMin = 0;
const int kPhaseDon[kPhaseLen] = {4, 4, 3, 3, 2, 2, 2, 2};
const int kPhaseKatsu[kPhaseLen] = {10, 10, 10, 0, 0, 0, 0, 0};

unsigned long ts_base = 0;
int note_off = 0;
bool is_katsu = 0;
int phase_off = kPhaseLen;
unsigned long now;

void setup() {
  pinMode(LED_BUILTIN, OUTPUT);
  pinMode(kPinPwm1, OUTPUT);

  ts_base = millis();
  now = ts_base;
}

struct Note {
  unsigned long ts;
  bool is_katsu;
};

struct Note getNote(int off) {
  uint32_t raw = pgm_read_dword(&(kYuugenData[off]));
  return Note{
    .ts = raw & 0x00ffffff,
    .is_katsu = (raw >> 24) > 2,
  };
}

void sleepUntil(unsigned long until) {
  while (millis() - until >= 0x80000000) {}
}

void loop() {
  unsigned long ts = now - ts_base;

  if (note_off < kYuugenLen) {
    auto note = getNote(note_off);
    if (ts + kPwmPeriodMs > note.ts) {
      digitalWrite(LED_BUILTIN, HIGH);
      is_katsu = note.is_katsu;
      phase_off = 0;
      ++note_off;
    }
  }

  int phase_val = phase_off == kPhaseLen ? kPhaseMin :
    is_katsu ? kPhaseKatsu[phase_off] : kPhaseDon[phase_off];

  digitalWrite(kPinPwm1, HIGH);
  sleepUntil(now + phase_val);

  digitalWrite(kPinPwm1, LOW);
  sleepUntil(now + kPhaseLen);

  digitalWrite(LED_BUILTIN, LOW);

  now += kPhaseLen;
  if (phase_off < kPhaseLen) ++phase_off;

  if (note_off == kYuugenLen && phase_off == kPhaseLen) while (true) { millis(); }
}

const uint32_t kYuugenData[1262] PROGMEM = {
0x01000000,
0x0200007d,
0x010000fa,
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0x0201d4f1,
};